#pragma once

#include <Arduino.h>
#include <SPI.h>


#define TFT_MOSI   19
#define TFT_SCLK   18
#define TFT_CS      5
#define TFT_DC     16
#define TFT_RST    23
#define TFT_BL      4

// ── Размеры в горизонтальной ориентации ──────────────────────
#define TFT_W     240   // ширина
#define TFT_H     135   // высота
#define TFT_COL_OFFSET  40
#define TFT_ROW_OFFSET  53

// ── Команды ST7789 ───────────────────────────────────────────
#define ST_SWRESET  0x01
#define ST_SLPOUT   0x11
#define ST_NORON    0x13
#define ST_INVON    0x21
#define ST_DISPON   0x29
#define ST_CASET    0x2A
#define ST_RASET    0x2B
#define ST_RAMWR    0x2C
#define ST_MADCTL   0x36
#define ST_COLMOD   0x3A

// ── Цвета RGB565 ─────────────────────────────────────────────
#define COLOR_BLACK   0x0000
#define COLOR_WHITE   0xFFFF
#define COLOR_RED     0xF800
#define COLOR_GREEN   0x07E0
#define COLOR_BLUE    0x001F
#define COLOR_CYAN    0x07FF
#define COLOR_YELLOW  0xFFE0
#define COLOR_ORANGE  0xFD20
#define COLOR_GREY    0x7BEF
#define COLOR_DKGREY  0x39C7
#define COLOR_DKBLUE  0x1082

// ── Шрифт 5x7 (ASCII 32–126) ────────────────────────────────
static const uint8_t FONT5X7[][5] PROGMEM = {
  {0x00,0x00,0x00,0x00,0x00}, // 32 ' '
  {0x00,0x00,0x5F,0x00,0x00}, // 33 '!'
  {0x00,0x07,0x00,0x07,0x00}, // 34 '"'
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  {0x10,0x08,0x08,0x10,0x08}, // 126 '~'
};


class ST7789 {
public:

  void begin() {
    pinMode(TFT_CS,  OUTPUT);
    pinMode(TFT_DC,  OUTPUT);
    pinMode(TFT_RST, OUTPUT);
    pinMode(TFT_BL,  OUTPUT);
    digitalWrite(TFT_BL, HIGH);

    SPI.begin(TFT_SCLK, -1, TFT_MOSI, TFT_CS);
    SPI.setFrequency(40000000);


    digitalWrite(TFT_RST, HIGH); delay(10);
    digitalWrite(TFT_RST, LOW);  delay(10);
    digitalWrite(TFT_RST, HIGH); delay(120);

  
    sendCmd(0x01); delay(150);  // SW Reset
    sendCmd(0x11); delay(120);  // Sleep Out
    sendCmd(0x3A); sendData(0x55); delay(10);  // 16bit color
    sendCmd(0x36); sendData(0x70); delay(10);  // MADCTL: горизонт, RGB
    sendCmd(0x21); delay(10);   // Inversion ON (нужно для T-Display)
    sendCmd(0x13); delay(10);   // Normal display ON
    sendCmd(0x29); delay(10);   

    fillScreen(COLOR_BLACK);
  }


  void fillScreen(uint16_t color) {
    setWindow(0, 0, TFT_W - 1, TFT_H - 1);
    uint32_t total = (uint32_t)TFT_W * TFT_H;
    uint8_t hi = color >> 8, lo = color & 0xFF;
    csLow(); dcHigh();
    for (uint32_t i = 0; i < total; i++) {
      SPI.transfer(hi); SPI.transfer(lo);
    }
    csHigh();
  }


  void fillRect(int16_t x, int16_t y, int16_t w, int16_t h, uint16_t color) {
    if (w <= 0 || h <= 0) return;
    if (x < 0) { w += x; x = 0; }
    if (y < 0) { h += y; y = 0; }
    if (x >= TFT_W || y >= TFT_H) return;
    if (x + w > TFT_W) w = TFT_W - x;
    if (y + h > TFT_H) h = TFT_H - y;
    if (w <= 0 || h <= 0) return;

    setWindow(x, y, x + w - 1, y + h - 1);
    uint32_t total = (uint32_t)w * h;
    uint8_t hi = color >> 8, lo = color & 0xFF;
    csLow(); dcHigh();
    for (uint32_t i = 0; i < total; i++) {
      SPI.transfer(hi); SPI.transfer(lo);
    }
    csHigh();
  }

  void drawHLine(int16_t x, int16_t y, int16_t len, uint16_t color) {
    fillRect(x, y, len, 1, color);
  }

  void drawRect(int16_t x, int16_t y, int16_t w, int16_t h, uint16_t color) {
    fillRect(x,         y,         w, 1, color);
    fillRect(x,         y + h - 1, w, 1, color);
    fillRect(x,         y,         1, h, color);
    fillRect(x + w - 1, y,         1, h, color);
  }

  void drawChar(int16_t x, int16_t y, char c,
                uint16_t fg, uint16_t bg, uint8_t scale = 1) {
    if (c < 32 || c > 126) c = '?';
    const uint8_t *glyph = FONT5X7[c - 32];
    for (uint8_t col = 0; col < 5; col++) {
      uint8_t bits = pgm_read_byte(&glyph[col]);
      for (uint8_t row = 0; row < 7; row++) {
        uint16_t color = (bits & (1 << row)) ? fg : bg;
        fillRect(x + col * scale, y + row * scale, scale, scale, color);
      }
    }
    fillRect(x + 5 * scale, y, scale, 7 * scale, bg);
  }

  int16_t drawString(int16_t x, int16_t y, const char *str,
                     uint16_t fg, uint16_t bg, uint8_t scale = 1) {
    int16_t cx = x;
    while (*str) {
      drawChar(cx, y, *str++, fg, bg, scale);
      cx += 6 * scale;
    }
    return cx;
  }

private:


  void setWindow(uint16_t x0, uint16_t y0, uint16_t x1, uint16_t y1) {
    uint16_t cx0 = x0 + TFT_COL_OFFSET;
    uint16_t cx1 = x1 + TFT_COL_OFFSET;
    uint16_t ry0 = y0 + TFT_ROW_OFFSET;
    uint16_t ry1 = y1 + TFT_ROW_OFFSET;

    sendCmd(ST_CASET);
    sendData(cx0 >> 8); sendData(cx0 & 0xFF);
    sendData(cx1 >> 8); sendData(cx1 & 0xFF);

    sendCmd(ST_RASET);
    sendData(ry0 >> 8); sendData(ry0 & 0xFF);
    sendData(ry1 >> 8); sendData(ry1 & 0xFF);

    sendCmd(ST_RAMWR);
  }

  void sendCmd(uint8_t cmd) {
    csLow(); dcLow();
    SPI.transfer(cmd);
    csHigh();
  }
  void sendData(uint8_t data) {
    csLow(); dcHigh();
    SPI.transfer(data);
    csHigh();
  }
  inline void csLow()  { digitalWrite(TFT_CS, LOW);  }
  inline void csHigh() { digitalWrite(TFT_CS, HIGH); }
  inline void dcLow()  { digitalWrite(TFT_DC, LOW);  }
  inline void dcHigh() { digitalWrite(TFT_DC, HIGH); }
};

